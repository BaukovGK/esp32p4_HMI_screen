## main/Kconfig.projbuild
```kconfig
menu "RO HMI Configuration"

    menu "Board options"
        config BOARD_I2C_SCAN_ON_BOOT
            bool "I2C scan on boot (debug, ~6s delay)"
            default n
            help
                Scans all 7-bit I2C addresses on boot, useful for debugging
                new hardware. Adds ~6 seconds startup delay. Disabled by default
                in production.
    endmenu

    menu "MQTT Settings"
        config MQTT_BROKER_URI
            string "MQTT Broker URI"
            default "mqtt://192.168.1.1:1883"
            help
                URI of the MQTT broker (Mosquitto on Orange Pi).

        config MQTT_CLIENT_ID
            string "MQTT Client ID"
            default "ro_hmi"
    endmenu

    menu "Ethernet Settings"
        config ETH_MDC_GPIO
            int "MDC GPIO"
            default 31

        config ETH_MDIO_GPIO
            int "MDIO GPIO"
            default 52

        config ETH_PHY_ADDR
            int "PHY Address"
            default 1

        config ETH_PHY_RST_GPIO
            int "PHY Reset GPIO (-1 if not used)"
            default 51
    endmenu

endmenu
```

## sdkconfig.defaults
```kconfig
# Target
CONFIG_IDF_TARGET="esp32p4"

# Flash
CONFIG_ESPTOOLPY_FLASHSIZE_16MB=y
CONFIG_ESPTOOLPY_FLASHMODE_QIO=y

# PSRAM (critical for MIPI DSI display)
CONFIG_SPIRAM=y
CONFIG_SPIRAM_SPEED_200M=y
CONFIG_SPIRAM_XIP_FROM_PSRAM=y
CONFIG_SPIRAM_BOOT_INIT=y
CONFIG_SPIRAM_MALLOC_ALWAYSINTERNAL=4096
CONFIG_SPIRAM_MALLOC_RESERVE_INTERNAL=65536

# L2 Cache (critical for PSRAM bandwidth)
CONFIG_CACHE_L2_CACHE_256KB=y
CONFIG_CACHE_L2_CACHE_LINE_128B=y

# Compiler optimization
CONFIG_COMPILER_OPTIMIZATION_PERF=y

# Experimental features (needed for PSRAM 200MHz)
CONFIG_IDF_EXPERIMENTAL_FEATURES=y

# Partition table
CONFIG_PARTITION_TABLE_CUSTOM=y
CONFIG_PARTITION_TABLE_CUSTOM_FILENAME="partitions.csv"

# FreeRTOS
CONFIG_FREERTOS_HZ=1000
CONFIG_FREERTOS_TIMER_TASK_STACK_DEPTH=4096
CONFIG_ESP_MAIN_TASK_STACK_SIZE=10240

# Task watchdog (UI init takes several seconds)
CONFIG_ESP_TASK_WDT_TIMEOUT_S=30

# LVGL
CONFIG_LV_COLOR_DEPTH_16=y
CONFIG_LV_FONT_MONTSERRAT_14=y
CONFIG_LV_USE_FONT_PLACEHOLDER=y
CONFIG_LV_ATTRIBUTE_FAST_MEM_USE_IRAM=y
CONFIG_LV_USE_CLIB_MALLOC=y
CONFIG_LV_USE_CLIB_STRING=y
CONFIG_LV_USE_CLIB_SPRINTF=y

# Ethernet (Waveshare ESP32-P4-NANO: IP101 PHY, RST на GPIO51)
CONFIG_ETH_USE_ESP32_EMAC=y
CONFIG_ETH_PHY_RST_GPIO=51

# Console (UART — через USB-UART мост на COM-порту прошивки)
CONFIG_ESP_CONSOLE_UART_DEFAULT=y

# Log level
CONFIG_LOG_DEFAULT_LEVEL_INFO=y

# I2C: разрешить одновременное использование legacy и нового драйвера
# (компонент waveshare/esp_lcd_jd9365 использует legacy i2c_bus,
#  а board_i2c и touch используют новый i2c_master API)
CONFIG_I2C_SKIP_LEGACY_CONFLICT_CHECK=y

# Отключить сборку LVGL демо-примеров (экономия flash)
CONFIG_LV_BUILD_EXAMPLES=n

# MQTT
CONFIG_MQTT_BUFFER_SIZE=2048
```
